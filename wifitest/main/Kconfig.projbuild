## wifitest/main/Kconfig.projbuild
```kconfig
menu "Configuração do Wifi Manager"

    config WIFI_SSID
        string "Wifi SSID"
        default "ssid"
        help
            Nome da rede Wifi

    config WIFI_PASSWORD
        string "Wifi Password"
        default "password"
        help
            Senha da rede Wifi (WPA or WPA2)

    config WIFI_MAXIMUM_RETRY
        int "Wifi Maximum Retry"
        default 5
        help
            Número máximo de tentativas de conexão com a rede Wifi.
endmenu
```
